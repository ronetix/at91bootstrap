## contrib/board/ronetix/sama5d3x_cm/sama5d3x_cm_gpio_test_defconfig
```kconfig
CONFIG_SAMA5D3X_CM=y
CONFIG_CPU_CLK_528MHZ=y
CONFIG_RAM_512MB=y
CONFIG_NANDFLASH=y
CONFIG_PMECC_AUTO_DETECT=n
CONFIG_PMECC_CORRECT_BITS_8=y
CONFIG_DEBUG=y
CONFIG_SCLK=y
CONFIG_LOAD_ONE_WIRE=y
CONFIG_GPIO_TEST=y
CONFIG_IMG_SIZE="0x80000"
CONFIG_IMG_ADDRESS = "0x00040000"
CONFIG_CRC32=y
```
