## contrib/board/ronetix/pm9g45/pm9g45_nf_linux_defconfig
```kconfig
CONFIG_PM9G45=y
CONFIG_NANDFLASH=y
CONFIG_DEBUG=y
CONFIG_THUMB=y
CONFIG_SCLK=y
CONFIG_ONFI_DETECT_SUPPORT=n
CONFIG_ON_DIE_ECC=y
CONFIG_USE_ON_DIE_ECC_SUPPORT=y
CONFIG_USE_PMECC=n
CONFIG_NANDFLASH_RECOVERY=n
CONFIG_IMG_ADDRESS="0x000200000"
CONFIG_IMG_SIZE="0x000800000"
CONFIG_LOAD_LINUX=y
CONFIG_RAM_64MB=y
CONFIG_OVERRIDE_CMDLINE=y
CONFIG_LINUX_KERNEL_ARG_STRING="console=ttyS0,115200 mtdparts=atmel_nand:10M(bootstrap/kernel),60M(rootfs),-(spare) root=ubi0:rootfs rw rootfstype=ubifs ubi.mtd=1,2048"
```

## contrib/board/ronetix/pm9g45/pm9g45_nf_uboot_defconfig
```kconfig
CONFIG_PM9G45=y
CONFIG_NANDFLASH=y
CONFIG_DEBUG=y
CONFIG_THUMB=y
CONFIG_SCLK=y
CONFIG_ONFI_DETECT_SUPPORT=n
CONFIG_ON_DIE_ECC=y
CONFIG_USE_ON_DIE_ECC_SUPPORT=y
CONFIG_USE_PMECC=n
CONFIG_NANDFLASH_RECOVERY=n
CONFIG_IMG_ADDRESS="0x00020000"
CONFIG_IMG_SIZE="0x00080000"
```

## contrib/board/ronetix/sam9x5_cm/sam9x5_cm_nf_uboot_defconfig
```kconfig
CONFIG_SAM9X5_CM=y
CONFIG_RAM_128MB=y
CONFIG_NANDFLASH=y
# CONFIG_PMECC_AUTO_DETECT is not set
CONFIG_IMG_SIZE="0x00050000"
CONFIG_DEBUG=y
CONFIG_THUMB=y
CONFIG_ONFI_DETECT_SUPPORT=n
```

## contrib/board/ronetix/sama5d3x_cm/sama5d3x_cm_nf_uboot_defconfig
```kconfig
CONFIG_SAMA5D3X_CM=y
CONFIG_CPU_CLK_528MHZ=y
CONFIG_RAM_512MB=y
CONFIG_NANDFLASH=y
CONFIG_PMECC_AUTO_DETECT=n
CONFIG_PMECC_CORRECT_BITS_8=y
CONFIG_DEBUG=y
CONFIG_SCLK=y
CONFIG_LOAD_ONE_WIRE=y
# CONFIG_REDUNDANT_IMAGES=y
CONFIG_IMG_SIZE="0x80000"
CONFIG_IMG_ADDRESS = "0x00040000"
CONFIG_IMG_1_ADDRESS="0x000C0000"
CONFIG_IMG_2_ADDRESS="0x00140000"
CONFIG_CRC32=y
```
